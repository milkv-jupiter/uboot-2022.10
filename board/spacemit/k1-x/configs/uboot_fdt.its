## board/spacemit/k1-x/configs/uboot_fdt.its
```
/dts-v1/;

/ {
	description = "U-boot FIT image for k1x";
	#address-cells = <2>;
	fit,fdt-list = "of-list";

	images {
		uboot {
			description = "U-Boot";
			type = "standalone";
			os = "U-Boot";
			arch = "riscv";
			compression = "none";
			load = <0x0 0x00200000>;
			data = /incbin/("../u-boot-nodtb.bin");
			hash-1 {
				algo = "crc32";
			};
		};

		fdt_1 {
			description = "k1-x_evb";
			type = "flat_dt";
			compression = "none";
			data = /incbin/("../dtb/k1-x_evb.dtb");
			hash-1 {
				algo = "crc32";
			};
		};
		fdt_2 {
			description = "k1-x_deb1";
			type = "flat_dt";
			compression = "none";
			data = /incbin/("../dtb/k1-x_deb1.dtb");
			hash-1 {
				algo = "crc32";
			};
		};
		fdt_3 {
			description = "k1-x_deb2";
			type = "flat_dt";
			compression = "none";
			data = /incbin/("../dtb/k1-x_deb2.dtb");
			hash-1 {
				algo = "crc32";
			};
		};
		fdt_4 {
			description = "k1-x_hs450";
			type = "flat_dt";
			compression = "none";
			data = /incbin/("../dtb/k1-x_hs450.dtb");
			hash-1 {
				algo = "crc32";
			};
		};
		fdt_5 {
			description = "k1-x_kx312";
			type = "flat_dt";
			compression = "none";
			data = /incbin/("../dtb/k1-x_kx312.dtb");
			hash-1 {
				algo = "crc32";
			};
		};
		fdt_6 {
			description = "k1-x_MINI-PC";
			type = "flat_dt";
			compression = "none";
			data = /incbin/("../dtb/k1-x_MINI-PC.dtb");
			hash-1 {
				algo = "crc32";
			};
		};
		fdt_7 {
			description = "k1-x_mingo";
			type = "flat_dt";
			compression = "none";
			data = /incbin/("../dtb/k1-x_mingo.dtb");
			hash-1 {
				algo = "crc32";
			};
		};
		fdt_8 {
			description = "k1-x_MUSE-N1";
			type = "flat_dt";
			compression = "none";
			data = /incbin/("../dtb/k1-x_MUSE-N1.dtb");
			hash-1 {
				algo = "crc32";
			};
		};
		fdt_9 {
			description = "k1-x_MUSE-Pi";
			type = "flat_dt";
			compression = "none";
			data = /incbin/("../dtb/k1-x_MUSE-Pi.dtb");
			hash-1 {
				algo = "crc32";
			};
		};
		fdt_10 {
			description = "k1-x_milkv-jupiter";
			type = "flat_dt";
			compression = "none";
			data = /incbin/("../dtb/k1-x_milkv-jupiter.dtb");
			hash-1 {
				algo = "crc32";
			};
		};
		fdt_11 {
			description = "k1-x_MUSE-Book.dtb";
			type = "flat_dt";
			compression = "none";
			data = /incbin/("../dtb/k1-x_MUSE-Book.dtb");
			hash-1 {
				algo = "crc32";
			};
		};
		fdt_12 {
                        description = "m1-x_milkv-jupiter";
                        type = "flat_dt";
                        compression = "none";
                        data = /incbin/("../dtb/m1-x_milkv-jupiter.dtb");
                        hash-1 {
                                algo = "crc32";
                        };
		};
		fdt_13 {
                        description = "k1-x_lpi3a";
                        type = "flat_dt";
                        compression = "none";
                        data = /incbin/("../dtb/k1-x_lpi3a.dtb");
                        hash-1 {
                                algo = "crc32";
                        };
                };
	};

	configurations {
		default = "conf_1";
		conf_1 {
			description = "k1-x_evb";
			loadables = "uboot";
			fdt = "fdt_1";
		};
		conf_2 {
			description = "k1-x_deb1";
			loadables = "uboot";
			fdt = "fdt_2";
		};
		conf_3 {
			description = "k1-x_deb2";
			loadables = "uboot";
			fdt = "fdt_3";
		};
		conf_4 {
			description = "k1-x_hs450";
			loadables = "uboot";
			fdt = "fdt_4";
		};
		conf_5 {
			description = "k1-x_kx312";
			loadables = "uboot";
			fdt = "fdt_5";
		};
		conf_6 {
			description = "k1-x_MINI-PC";
			loadables = "uboot";
			fdt = "fdt_6";
		};
		conf_7 {
			description = "k1-x_mingo";
			loadables = "uboot";
			fdt = "fdt_7";
		};
		conf_8 {
			description = "k1-x_MUSE-N1";
			loadables = "uboot";
			fdt = "fdt_8";
		};
		conf_9 {
			description = "k1-x_MUSE-Pi";
			loadables = "uboot";
			fdt = "fdt_9";
		};
		conf_10 {
			description = "k1-x_milkv-jupiter";
			loadables = "uboot";
			fdt = "fdt_10";
		};
		conf_11 {
			description = "k1-x_MUSE-Book";
			loadables = "uboot";
			fdt = "fdt_11";
		};
		conf_12 {
                        description = "m1-x_milkv-jupiter";
                        loadables = "uboot";
                        fdt = "fdt_12";
                };
		 conf_13 {
                        description = "k1-x_lpi3a";
                        loadables = "uboot";
                        fdt = "fdt_13";
                };

	};
};
```

## drivers/power/battery/Kconfig
```kconfig
config DM_BATTERY
	bool "Enable Driver Model for BATTERY drivers (UCLASS_BATTERY)"
	depends on DM
	---help---
	This config enables driver model battery support.

config CW2015_BATTERY
	bool "Enable Driver Model for SPACEMIT CW2015 battery"
	depends on DM_BATTERY
	help
	This config enables driver model for cw2015 battery
```

## drivers/power/charger/Kconfig
```kconfig
config DM_CHARGER
	bool "Enable Driver Model for charger drivers (UCLASS_CHARGER)"
	depends on DM
	---help---
	This config enables driver model charger support.

config SGM41515_CHARGER
	bool "Enable Driver Model for SPACEMIT sgm41515 charger"
	depends on DM_CHARGER
	help
	This config enables driver model for sgm41515 charger.
```
